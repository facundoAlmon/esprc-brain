## Firmware/sdkconfig.defaults
```kconfig
#
# ESP32 options
#
# Re-enable OPTIMIZATION_PERF when these bugs are fixed:
# https://github.com/espressif/arduino-esp32/issues/9784
# https://github.com/espressif/arduino-esp32/issues/9607
#CONFIG_COMPILER_OPTIMIZATION_PERF=y

CONFIG_ESPTOOLPY_FLASHSIZE_8MB=y

CONFIG_ESP32_XTAL_FREQ_AUTO=y
CONFIG_PARTITION_TABLE_CUSTOM=y
CONFIG_PARTITION_TABLE_CUSTOM_FILENAME="partitions.csv"

#
# Bluetooth — Bluedroid host stack + HID host (replaces btstack/bluepad32)
#
CONFIG_BT_ENABLED=y
CONFIG_BT_BLUEDROID_ENABLED=y
# Controller: dual-mode (Classic BT + BLE) for both Xbox BLE and generic BT gamepads
CONFIG_BTDM_CTRL_MODE_BTDM=y
CONFIG_BTDM_CTRL_BR_EDR_MAX_ACL_CONN=3
CONFIG_BTDM_CTRL_BLE_MAX_CONN=3
CONFIG_BTDM_CTRL_BR_EDR_MAX_SYNC_CONN=0
CONFIG_BTDM_CTRL_AUTO_LATENCY=y
CONFIG_BTDM_CTRL_MODEM_SLEEP=n
# Classic BT HID Host profile (for BR/EDR gamepads)
CONFIG_BT_HID_HOST_ENABLED=y

CONFIG_ESP_COREDUMP_ENABLE_TO_FLASH=y

# MBEDTLS
CONFIG_MBEDTLS_PSK_MODES=y
CONFIG_MBEDTLS_KEY_EXCHANGE_PSK=y
CONFIG_MBEDTLS_KEY_EXCHANGE_DHE_PSK=y
CONFIG_MBEDTLS_KEY_EXCHANGE_ECDHE_PSK=y
CONFIG_MBEDTLS_KEY_EXCHANGE_RSA_PSK=y

#
# FreeRTOS
#
# Enable FreeRTOS stats formatting functions, needed for 'tasks' console command
CONFIG_FREERTOS_USE_TRACE_FACILITY=y
CONFIG_FREERTOS_USE_STATS_FORMATTING_FUNCTIONS=y
# Needed for ArduinoCore v2.0.5
CONFIG_FREERTOS_HZ=1000

CONFIG_ESP_WIFI_IRAM_OPT=n
CONFIG_ESP_WIFI_RX_IRAM_OPT=n
CONFIG_HTTPD_WS_SUPPORT=y
CONFIG_LWIP_IPV6=n

CONFIG_COMPILER_OPTIMIZATION_DEBUG=n
CONFIG_COMPILER_OPTIMIZATION_SIZE=y
CONFIG_ESP_SYSTEM_EVENT_TASK_STACK_SIZE=16384
```

## Firmware/sdkconfig.defaults.esp32c6
```kconfig
# Increase main task stack size for ESP32C6 build (eg: idf.py set-target esp32c6).
CONFIG_ESP_MAIN_TASK_STACK_SIZE=4096

# C6 is BLE-only — Classic BT HID host not available
# CONFIG_BT_HID_HOST_ENABLED is not set
CONFIG_BT_BLE_ENABLED=y
CONFIG_BT_BLE_42_FEATURES_SUPPORTED=y
```
